## fs/datafs/Kconfig
```kconfig
# SPDX-License-Identifier: GPL-2.0-only

config DATAFS_FS
	tristate "Data filesystem over TCP and BPF"
	depends on INET
	depends on BPF_SYSCALL
	depends on BPF_JIT
	select NETFS_SUPPORT
	help
	  datafs is an experimental read-only filesystem that uses netfslib for
	  regular-file reads and BPF struct_ops callbacks for protocol
	  framing and response decoding.  Ordinary operations use a bounded TCP
	  connection pool.

	  If unsure, say N.
```

## fs/tcpfs/Kconfig
```kconfig
# SPDX-License-Identifier: GPL-2.0-only

config TCPFS_FS
	tristate "TCP-backed BPF callback filesystem"
	depends on INET
	depends on BPF_SYSCALL
	depends on BPF_JIT
	help
	  tcpfs is an experimental read-only filesystem that delegates
	  protocol framing and result decoding to BPF struct_ops callbacks
	  and transports requests over TCP.

	  If unsure, say N.
```
